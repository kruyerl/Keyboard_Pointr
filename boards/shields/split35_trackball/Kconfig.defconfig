## boards/shields/split35_trackball/Kconfig.defconfig
```kconfig
if SHIELD_SPLIT35_TRACKBALL_RIGHT
    config ZMK_KEYBOARD_NAME
        default "Split35 Trackball"

    config ZMK_SPLIT_ROLE_CENTRAL
        default y
endif

if SHIELD_SPLIT35_TRACKBALL_LEFT || SHIELD_SPLIT35_TRACKBALL_RIGHT
    config ZMK_SPLIT
        default y
endif
```

## boards/shields/split35_trackball/Kconfig.shield
```kconfig
config SHIELD_SPLIT35_TRACKBALL_LEFT
    def_bool $(shields_list_contains,split35_trackball_left)

config SHIELD_SPLIT35_TRACKBALL_RIGHT
    def_bool $(shields_list_contains,split35_trackball_right)
```
